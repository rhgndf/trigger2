## Kconfig
```kconfig
# SPDX-License-Identifier: GPL-2.0-only
config DRM_TRIGGER2
	tristate "MCT Trigger II USB display adapters"
	depends on DRM && USB && MMU
	select DRM_CLIENT_SELECTION
	select DRM_GEM_SHMEM_HELPER
	select DRM_KMS_HELPER
	help
	  DRM driver for USB display adapters based on the MCT Trigger II
	  chipset, including the j5create JUA230 and JUA230U.

	  To compile this driver as a module, choose M here: the module
	  will be called trigger2.
```
